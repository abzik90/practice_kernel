/dts-v1/;
/plugin/;
/ {
	compatible = "brcm,bcm2835";
	fragment@0 {
		target-path = "/";
		__overlay__ {
			my_device {
				compatible = "my_custom_device";
				status = "okay";
				label = "Test";
				value = <12>;
			};
		};
	};
};